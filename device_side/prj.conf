## CMakeLists.txt
```
# Copyright (c) 2023 Linaro
# SPDX-License-Identifier: Apache-2.0
cmake_minimum_required(VERSION 3.20.0)

#list(APPEND QEMU_EXTRA_FLAGS -S)
#list(APPEND QEMU_EXTRA_FLAGS -s)

find_package(Zephyr REQUIRED HINTS $ENV{ZEPHYR_BASE})
project(virtio_mmmio_serial)

target_sources(app PRIVATE src/virtio-mmio-backend-serial.c
        src/virtio-mmio-backend.c)
```

## prj.conf
```kconfig
CONFIG_IPM=y
CONFIG_OPENAMP=y
CONFIG_SERIAL=y
CONFIG_VIRTIO_MMIO=n
```

## boards/lpcxpresso55s69_cpu0.conf
```kconfig
CONFIG_IPM_MCUX=y
CONFIG_SECOND_CORE_MCUX=n
# CONFIG_SECOND_IMAGE_MCUX="${ZEPHYR_BINARY_DIR}/../openamp_remote-prefix/src/openamp_remote-build/zephyr/zephyr.bin"
```

## boards/qemu_cortex_a53.conf
```kconfig
CONFIG_PCIE_CONTROLLER=y
CONFIG_PCIE_ECAM=y

# Hungry PCI requires at least 256M of virtual space
CONFIG_KERNEL_VM_SIZE=0x80000000

# Hungry PCI requires phys addresses with more than 32 bits
CONFIG_ARM64_VA_BITS_40=y
CONFIG_ARM64_PA_BITS_40=y

# MSI support requires ITS
CONFIG_GIC_V3_ITS=y

# ITS, in turn, requires dynamic memory (9x64 + alignment constrains)
# Additionally, our test also uses malloc
CONFIG_HEAP_MEM_POOL_SIZE=1048576
CONFIG_IPM_IVSHMEM_EVENT_LOOP_PRIO=0

CONFIG_PCIE=y
# required by doorbell
CONFIG_PCIE_MSI=y
CONFIG_PCIE_MSI_X=y
CONFIG_PCIE_MSI_MULTI_VECTOR=y
CONFIG_POLL=y

CONFIG_VIRTUALIZATION=y
CONFIG_IVSHMEM=y
CONFIG_IVSHMEM_DOORBELL=y

CONFIG_SHELL=n
CONFIG_IVSHMEM_SHELL=n
```

## boards/lpcxpresso55s69_cpu0.overlay
```dts
/*
 * Copyright (c) 2019 Linaro Limited
 *
 * SPDX-License-Identifier: Apache-2.0
 */

 / {
	chosen {
		zephyr,ipc_shm = &sram4duplicate;
		zephyr,ipc = &mailbox0;
	};

	aliases {
		uart0 = &flexcomm0;
	};

	/* This is a duplication of sram4, workaround */
	sram4duplicate: memory@20040000 {
		compatible = "mmio-sram";
		reg = <0x20040000 DT_SIZE_K(16)>;
	};
};
```

## boards/qemu_cortex_a53.overlay
```dts
/*
 * Copyright 2023 Linaro.
 *
 * SPDX-License-Identifier: Apache-2.0
 */
 #include "pcie_ivshmem.dtsi"

 / {
        ipm_ivshmem0: ipm_ivshmem {
            compatible = "linaro,ivshmem-ipm";
            ivshmem = <&ivshmem0>;
            status = "okay";
        };
 };
```

## src/virtio-mmio-backend-serial.c
```c
/*
 * Copyright 2023 Linaro.
 *
 * SPDX-License-Identifier: Apache-2.0
 */

#include <stdio.h>
#include <stdlib.h>

#include <zephyr/kernel.h>
#include <zephyr/drivers/ipm.h>
#include <zephyr/drivers/virtualization/ivshmem.h>
#include <zephyr/drivers/uart.h>
#include <openamp/virtio_serial.h>
#include "virtio-mmio-backend.h"

#if defined(CONFIG_IVSHMEM)
const struct device *ivshmem_dev = DEVICE_DT_GET(DT_NODELABEL(ivshmem0));
const struct device *ipm_dev = DEVICE_DT_GET(DT_NODELABEL(ipm_ivshmem0));
const struct device *serial_dev = DEVICE_DT_GET(DT_NODELABEL(uart0));
#else
const struct device *ivshmem_dev = NULL;
const struct device *ipm_dev = DEVICE_DT_GET(DT_CHOSEN(zephyr_ipc));
const struct device *serial_dev = DEVICE_DT_GET(DT_NODELABEL(flexcomm0));
#endif

enum virtio_serial_backend_state {
	VIRTIO_SERIAL_DEV_READY = 0,
	VIRTIO_SERIAL_DEV_CFG_ACK,
	VIRTIO_SERIAL_DEV_CFG_DRIVER,
	VIRTIO_SERIAL_DEV_SET_FEATURES,
	VIRTIO_SERIAL_DEV_UNKNOWN,
};

static struct virtio_mmio_backend_serial {
	struct virtio_mmio_backend virtio_mmio_backend_dev;
	struct vring_information vrings[2];
	int vq_count;
	enum virtio_serial_backend_state state;
} serial_backend_dev = {.vq_count = 2, .state = VIRTIO_SERIAL_DEV_UNKNOWN};


static void ipm_platform_callback(const struct device *ipmdev, void *user_data,
			       uint32_t id, volatile void *data)
{
	ARG_UNUSED(ipmdev);
	ARG_UNUSED(user_data);
	virtio_mmio_backend_isr();
}

void virtio_mmio_backend_handler(struct virtio_mmio_backend *dev,
							uint32_t status,
							void *argument)
{
	if (status & VIRTIO_CONFIG_STATUS_DRIVER_OK && (serial_backend_dev.state != VIRTIO_SERIAL_DEV_READY)) {
		printk("Config Status DRIVER_OK \n");
		serial_backend_dev.state = VIRTIO_SERIAL_DEV_READY;
		return;

	} else if (serial_backend_dev.state == VIRTIO_SERIAL_DEV_UNKNOWN ) {
		/* virtqueue setup phase */
		int idx = virtio_mmio_backend_get_queue_id(dev);
		virtio_mmio_backend_get_vring(dev, &serial_backend_dev.vrings[idx]);

	} else if (serial_backend_dev.state == VIRTIO_SERIAL_DEV_READY) {
		int queue_id = virtio_mmio_backend_get_active_queue(dev);

		uint16_t index = serial_backend_dev.vrings[queue_id].used->idx %
					serial_backend_dev.vrings[queue_id].queue_num;
		uint16_t desc_index = serial_backend_dev.vrings[queue_id].avail->ring[index];

		if (queue_id == 0 &&
				(void *)serial_backend_dev.vrings[queue_id].desc[desc_index].addr != NULL) {

			/* is a poll in operation */
			if(!uart_poll_in(serial_dev,
						(uint8_t *)&serial_backend_dev.vrings[queue_id].desc[desc_index].addr)) {
				/* received data, forward this data to the driver */
				serial_backend_dev.vrings[queue_id].used->ring[index].len = 1;
			} else {
				serial_backend_dev.vrings[queue_id].used->ring[index].len = 0;
			}

		} else if (queue_id == 1 &&
					(void *)serial_backend_dev.vrings[queue_id].desc[desc_index].addr != NULL) {
			/* is a poll out operation */
			uint8_t c = *(uint8_t*)(serial_backend_dev.vrings[queue_id].desc[desc_index].addr);

			uart_poll_out(serial_dev, c);
			serial_backend_dev.vrings[queue_id].used->ring[index].len = 1;
		} else {
			/* descriptor is invalid, skip it:*/
			printk("Invalid descriptor! \n");
			return;
		}

		serial_backend_dev.vrings[queue_id].used->ring[index].id =
								serial_backend_dev.vrings[queue_id].avail->ring[index];
		serial_backend_dev.vrings[queue_id].used->idx++;

		virtio_mmio_backend_raise_interrupt(dev);

#if defined(CONFIG_IVSHMEM)
		ipm_send(ipm_dev, 0, ivshmem_get_id(ivshmem_dev) + 1, NULL, 0);
#else
		ipm_send(ipm_dev, 0, 0, NULL, 0);
#endif
	}
}

int main(void)
{
	uintptr_t virtio_mmio_cfg_area;
	int shmem_area_size;

#if defined(CONFIG_IVSHMEM)
	shmem_area_size = ivshmem_get_mem(ivshmem_dev, &virtio_mmio_cfg_area);
#else
	virtio_mmio_cfg_area = (uintptr_t) (DT_REG_ADDR(DT_CHOSEN(zephyr_ipc_shm)));
	shmem_area_size = DT_REG_SIZE(DT_CHOSEN(zephyr_ipc_shm));
#endif

	/* device side initializes IVSHMEM before usage*/
	memset((void *)virtio_mmio_cfg_area, 0, shmem_area_size);

	ipm_register_callback(ipm_dev, ipm_platform_callback, NULL);
	ipm_set_enabled(ipm_dev, 1);

	virtio_mmio_backend_initialize(&serial_backend_dev.virtio_mmio_backend_dev,
						virtio_mmio_cfg_area,
						VIRTIO_ID_CONSOLE,
						virtio_mmio_backend_handler,
						NULL);

	virtio_mmio_backend_register(&serial_backend_dev.virtio_mmio_backend_dev);

	return 0;
}
```

## src/virtio-mmio-backend.c
```c
/*
 * Copyright 2023 Linaro.
 *
 * SPDX-License-Identifier: Apache-2.0
 */

#include <errno.h>
/* TODO: get rid of sys_/write/read from zephyr and
 * use metal_io_region instead
 */
#include <zephyr/kernel.h>
#include "virtio-mmio-backend.h"

static METAL_DECLARE_LIST(virtio_mmio_backend_list);

int virtio_mmio_backend_initialize(struct virtio_mmio_backend *dev,
                                uintptr_t config_mem_ptr,
                                uint32_t device_type,
                                virtio_mmio_backend_callback cb,
                                void *user_data)
{
    if(!dev || !config_mem_ptr || !cb)
        return -EINVAL;

    dev->config_mem_base = config_mem_ptr;
    dev->device_type = device_type;
    dev->cb = cb;
    dev->user_data = user_data;
    return 0;
}

int virtio_mmio_backend_register(struct virtio_mmio_backend *dev)
{
    if(!dev)
        return -EINVAL;

    /*Expose in the config shared memory which device we are:*/
    sys_write32(VIRTIO_MMIO_MAGIC_VALUE_STRING,
            dev->config_mem_base + VIRTIO_MMIO_MAGIC_VALUE);

    sys_write32(1,
            dev->config_mem_base + VIRTIO_MMIO_VERSION);

    sys_write32(dev->device_type,
            dev->config_mem_base + VIRTIO_MMIO_DEVICE_ID);

    sys_write32(0,
        dev->config_mem_base + VIRTIO_MMIO_QUEUE_PFN);

    sys_write32(0,
            dev->config_mem_base + VIRTIO_MMIO_INTERRUPT_ACK);

    /* For the HVL Virtio cases we need to provide to the driver
     * side a non-zero len and memory address into the shm register
     */
    uint32_t shm_base = (dev->config_mem_base >> 32);

	sys_write32(shm_base ,dev->config_mem_base + VIRTIO_MMIO_SHM_BASE_HIGH);
	shm_base = dev->config_mem_base & 0xFFFFFFFF;
	sys_write32(shm_base ,dev->config_mem_base + VIRTIO_MMIO_SHM_BASE_LOW);

	sys_write32(0, dev->config_mem_base + VIRTIO_MMIO_SHM_LEN_HIGH);
	sys_write32(0x200, dev->config_mem_base + VIRTIO_MMIO_SHM_LEN_LOW);

    printk("Dump the configuration for the virtio mmio device %p\n", dev);
    printk("VIRTIO_MMIO Device Base address: %p\n",
        (void *)(dev->config_mem_base + VIRTIO_MMIO_MAGIC_VALUE));
    printk("VIRTIO_MMIO_MAGIC_VALUE: 0x%x\n",
        sys_read32(dev->config_mem_base + VIRTIO_MMIO_MAGIC_VALUE));
    printk("VIRTIO_MMIO_VERSION: 0x%x\n",
        sys_read32(dev->config_mem_base + VIRTIO_MMIO_VERSION));
    printk("VIRTIO_MMIO_DEVICE_ID: 0x%x\n",
        sys_read32(dev->config_mem_base + VIRTIO_MMIO_DEVICE_ID));

    metal_list_add_tail(&virtio_mmio_backend_list, &dev->link);

    return 0;
}

int virtio_mmio_backend_get_vring(struct virtio_mmio_backend *dev,
                                struct vring_information *vr)
{

    if(!dev || !dev->config_mem_base || !vr)
        return -EINVAL;

    uintptr_t addr = (uintptr_t)sys_read32(dev->config_mem_base + VIRTIO_MMIO_QUEUE_PFN);
    if(!addr || (addr == 0xAABBAABB)) {
        return -ENOMEM;
    }

    virtio_mmmio_backend_hvl_ack(dev);

    int align = sys_read32(dev->config_mem_base + VIRTIO_MMIO_QUEUE_ALIGN);
    int n = sys_read32(dev->config_mem_base + VIRTIO_MMIO_QUEUE_NUM);
    addr *= align;

    /* setup the vring */
    vr->desc = (void *)addr;
    vr->avail = (void *)((unsigned long)addr +
                n * sizeof(struct vring_desc));
    vr->used = (void *)((unsigned long)addr +
                ((n * sizeof(struct vring_desc) +
                (n + 1) * sizeof(uint16_t) + align - 1) & ~(align - 1)));
    vr->queue_num = n;

    printk("Dump of incoming Vring information from other side:\n");
    printk("vring descriptor: %p:\n", vr->desc);
    printk("vring avail: %p:\n", vr->avail);
    printk("vring used: %p:\n", vr->used);
    printk("vring entries: %d:\n", vr->queue_num);

    if(!vr->desc || !vr->avail || !vr->used)
        return -ENODEV;

    return 0;
}

int virtio_mmio_backend_raise_interrupt(struct virtio_mmio_backend *dev)
{
    if(!dev)
        return -EINVAL;

    sys_write32(VIRTIO_MMIO_INT_VRING,
            dev->config_mem_base + VIRTIO_MMIO_INTERRUPT_STATUS);

    return 0;
}

uint32_t virtio_mmio_backend_get_status(struct virtio_mmio_backend *dev)
{
    if(!dev)
        return -EINVAL;

    return (sys_read32(dev->config_mem_base + VIRTIO_MMIO_STATUS));
}

int virtio_mmio_backend_get_active_queue(struct virtio_mmio_backend *dev)
{
    if(!dev)
        return -EINVAL;

    return (int)(sys_read32(dev->config_mem_base + VIRTIO_MMIO_QUEUE_NOTIFY));
}

int virtio_mmio_backend_get_queue_id(struct virtio_mmio_backend *dev)
{
    if(!dev)
        return -EINVAL;

    return (int)(sys_read32(dev->config_mem_base + VIRTIO_MMIO_DRIVER_FEATURES_SEL));
}

int virtio_mmmio_backend_hvl_ack(struct virtio_mmio_backend *dev)
{
    if(!dev)
        return -EINVAL;

    sys_write32(0xAABBAABB,
            dev->config_mem_base + VIRTIO_MMIO_QUEUE_PFN);

    return 0;
}

int virtio_mmio_backend_isr(void)
{
    struct metal_list *node;
    struct virtio_mmio_backend *dev;

    metal_list_for_each(&virtio_mmio_backend_list, node) {
		dev = metal_container_of(node, struct virtio_mmio_backend, link);

        uint32_t ack = sys_read32(dev->config_mem_base +
                                VIRTIO_MMIO_INTERRUPT_ACK);

        if(ack & VIRTIO_MMIO_INT_VRING) {
            /* just an int ack, ignore it */
            sys_write32(0,
                dev->config_mem_base + VIRTIO_MMIO_INTERRUPT_ACK);
            return 0;
        }

        /* read status and defer callback if needed */
        uint32_t status = sys_read32(dev->config_mem_base +
                                VIRTIO_MMIO_STATUS);

        if(dev->cb)
            dev->cb(dev, status, dev->user_data);
	}

    return 0;
}
```

## src/virtio-mmio-backend.h
```c
/*
 * Copyright 2023 Linaro.
 *
 * SPDX-License-Identifier: Apache-2.0
 */

#ifndef __VIRTIO_MMIO_BACKEND_H
#define __VIRTIO_MMIO_BACKEND_H

#include <stdint.h>
#include <stdbool.h>
#include <openamp/virtqueue.h>
#include <openamp/virtio_ring.h>
#include <openamp/virtio.h>
#include <openamp/virtio_mmio.h>
#include <openamp/virtio_mmio_hvl.h>
#include <metal/device.h>

struct vring_information {
	volatile struct vring_desc *desc;
	volatile struct vring_avail *avail;
	volatile struct vring_used *used;
    int queue_num;
};

struct virtio_mmio_backend;

typedef void (*virtio_mmio_backend_callback) (struct virtio_mmio_backend *dev,
                                    uint32_t status,
                                    void *argument);

struct virtio_mmio_backend {
    struct metal_list link;
    uintptr_t config_mem_base;
    uint32_t device_type;
    virtio_mmio_backend_callback cb;
    void *user_data;
};

int virtio_mmio_backend_initialize(struct virtio_mmio_backend *dev,
                            uintptr_t config_mem_ptr,
                            uint32_t device_type,
                            virtio_mmio_backend_callback cb,
                            void *user_data);

int virtio_mmio_backend_register(struct virtio_mmio_backend *dev);

int virtio_mmio_backend_get_vring(struct virtio_mmio_backend *dev,
                                struct vring_information *vr);

int virtio_mmio_backend_get_active_queue(struct virtio_mmio_backend *dev);

int virtio_mmio_backend_get_queue_id(struct virtio_mmio_backend *dev);

int virtio_mmio_backend_raise_interrupt(struct virtio_mmio_backend *dev);

uint32_t virtio_mmio_backend_get_status(struct virtio_mmio_backend *dev);

int virtio_mmmio_backend_hvl_ack(struct virtio_mmio_backend *dev);

int virtio_mmio_backend_isr(void);


#endif
```
